/*OLED底层驱动
*@采用列行式，分辨率为128*64
*存放格式如下.
*[0]0 1 2 3 ... 127	
*[1]0 1 2 3 ... 127	
*[2]0 1 2 3 ... 127	
*[3]0 1 2 3 ... 127	
*[4]0 1 2 3 ... 127	
*[5]0 1 2 3 ... 127	
*[6]0 1 2 3 ... 127	
*[7]0 1 2 3 ... 127 
*/


/**
	OLED引脚定义
	C2 D/C
	C1 RST
	C3 SDA
	B10 CLK
	供电：5V
	地：任意

	*/





#include "stm32f4xx_hal.h"
#include "stdlib.h"
#include "OLED.h"



#define XLevelL		0x00
#define XLevelH		0x10
#define XLevel		((XLevelH&0x0F)*16+XLevelL)
#define Max_Column	128
#define Max_Row		  64
#define	Brightness	0xFF 


//======================================
const unsigned char F6x8[][8] =		
{
	0x00,0x00,0x00,0x00,0x00,0x00,0x00,0x00, // sp
	0x10,0x10,0x10,0x10,0x00,0x10,0x00,0x00, // !
	0x28,0x28,0x28,0x00,0x00,0x00,0x00,0x00, // "
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	0x00,0x00,0x00,0x20,0x54,0x08,0x00,0x00, // ~
};

//======================================================
// 128X64I液晶底层驱动[8X16]字体库
// 描  述: [8X16]西文字符的字模数据 (纵向取模,字节倒序)
// !"#$%&'()*+,-./0123456789:;<=>?@ABCDEFGHIJKLMNOPQRSTUVWXYZ[\]^_`abcdefghijklmnopqrstuvwxyz{|}~
//======================================================
const unsigned char F8X16[]=	  
{
  0x00,0x00,0x00,0x00,0x00,0x00,0x00,0x00,0x00,0x00,0x00,0x00,0x00,0x00,0x00,0x00,// 0
  0x00,0x00,0x00,0x18,0x18,0x18,0x18,0x18,0x18,0x18,0x00,0x00,0x18,0x18,0x00,0x00,//! 1
  0x00,0x12,0x36,0x24,0x48,0x00,0x00,0x00,0x00,0x00,0x00,0x00,0x00,0x00,0x00,0x00,//" 2
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	0xff,0xff,0xff,0xff,0xff,0xff,0xff,0xff,0xff,0xff,0xff,0xff,0xff,0xff,0xff,0xff //■ 95
};

extern DMA_HandleTypeDef hdma_spi2_tx;

uint8_t OLED_Data_Buff[OLED_HEIGHT/8*OLED_WIDTH] = {0};


static void SPI_Send_OLED(uint8_t *data,uint32_t size)
{
  /* 判断上次DMA有没有传输完成 */
	while(HAL_DMA_GetState(&hdma_spi2_tx) != HAL_DMA_STATE_READY);
  /* 发送数据 */
	HAL_SPI_Transmit_DMA(&hspi2,data,size); 
}

/**@brief 传输数据
	*@param 传输的数据
	*@retval NONE
	*/
void OLED_WrData(uint8_t *data,uint32_t size)
{
	OLED_DC_SET();
	SPI_Send_OLED(data,size);
	OLED_DC_RST();
 }

 /**@brief  传输指令
	 *@param  指令
	 *@retval NONE
	 */
 void OLED_WrCmd(uint8_t cmd)
{
	OLED_DC_RST();
	SPI_Send_OLED(&cmd,1);
}

 /**@brief  显示函数，将缓冲区中的内容显示
	 *@param  NONE
	 *@retval NONE
	 */
void OLED_Display(void)
{
	uint8_t y,x;
	OLED_DC_RST();
	for(y=0;y<8;y++)
	{
		OLED_WrCmd(0xb0+y);//设置页地址 0to7
		OLED_WrCmd(0x01);	//设置列地址
		OLED_WrCmd(0x10);	//设置列地址
		for(x=0;x<OLED_WIDTH;x++)
		{
			OLED_WrData(&OLED_Data_Buff[y*OLED_WIDTH+x],1);
		}
	}
}

 /**@brief  移动画笔到选定位置
	 *@param  x,y
	 *@retval NONE
	 */
void OLED_Set_Pos(uint8_t x, uint8_t y)
{ 
  OLED_WrCmd(0xb0+(y>>3));
  OLED_WrCmd(((x&0xf0)>>4)|0x10);
  OLED_WrCmd((x&0x0f)|0x01); 
} 

 /**@brief  填充函数
	 *@param  填充类型
	 *@retval NONE
	 */
void OLED_Fill(uint8_t bmp_data)
{
	uint8_t y,x;
	
	for(y=0;y<8;y++)
	{

		for(x=0;x<OLED_WIDTH;x++)
		{
			OLED_Data_Buff[y * OLED_WIDTH + x]=bmp_data;
		}
	}
}

 /**@brief  设置一个像素的颜色
	 *@param  x,y，颜色（0/1）
	 *@retval NONE
	 */
void OLED_Set_Pixel(unsigned char x, unsigned char y,unsigned char color)
{
	if(color)
	{
		OLED_Data_Buff[(y/8)*OLED_WIDTH+x]|= (1<<(y%8))&0xff;
	}
	else
	{
		OLED_Data_Buff[(y/8)*OLED_WIDTH+x]&= ~((1<<(y%8))&0xff);
	}
}	

 /**@brief  显示字符
	 *@param  x,y，字符，大小，模式（黑底白字，白底黑字）
	 *@retval NONE
	 */
void GUI_ShowChar(uint8_t x,uint8_t y,uint8_t chr,uint8_t Char_Size,uint8_t mode)
{      	
	  unsigned char c=0,i=0,tmp,j=0;	
		c=chr-' ';//得到偏移后的值			
		if(x>OLED_WIDTH-1){x=0;y=y+2;}
		if(Char_Size ==16)
		{
			for(i=0;i<16;i++)
			{
			  if(mode)
				{
					tmp = F8X16[c*16+i];
				}
				else
				{
					tmp = ~(F8X16[c*16+i]);
				}
				for(j=0;j<8;j++)
				{
					if(tmp&(0x80>>j))
					{
						OLED_Set_Pixel(x+j, y+i,1);
					}
					else
					{
						OLED_Set_Pixel(x+j, y+i,0);
					}
				}
			}
		}
		else if(Char_Size==8)
		{	
				for(i=0;i<8;i++)
				{
				  if(mode)
					{
						tmp = F6x8[c][i];
					}
					else
					{
						tmp = ~(F6x8[c][i]);
					}
					for(j=0;j<8;j++)
					{
						if(tmp&(0x80>>j))
						{
							OLED_Set_Pixel(x+j, y+i,1);
						}
						else
						{
							OLED_Set_Pixel(x+j, y+i,0);
						}
					}
			}
	}
	else
	{
		return;
	}
}

 /**@brief  显示字符串
	 *@param  x,y，字符指针，大小，模式（黑底白字，白底黑字）
	 *@retval NONE
	 */
void GUI_ShowString(uint8_t x,uint8_t y,uint8_t *chr,uint8_t Char_Size,uint8_t mode)
{
	uint16_t offset = 0;
	while(chr[offset]!='\0')
	{
		GUI_ShowChar(x+((Char_Size+4)*offset)/2,y,chr[offset],Char_Size,mode);
		offset++;
	}
}

 /**@brief  清屏
	 *@param  NONE
	 *@retval NONE
	 */
void LCD_CLS(void)
{
	uint8_t y,x;	
	for(y=0;y<8;y++)
	{
		OLED_WrCmd(0xb0+y);
		OLED_WrCmd(0x01);
		OLED_WrCmd(0x10); 
		for(x=0;x<OLED_WIDTH;x++)
		{
			OLED_Data_Buff[x]=0;
		}
	}
	OLED_Display();
}

 /**@brief  初始化OLED屏幕
	 *@param  NONE
	 *@retval NONE
	 */
void OLED_Init(void)        
{
	HAL_Delay(50);
	OLED_RST_SET();
	HAL_Delay(100);
	OLED_RST_RST();
	HAL_Delay(100);
	OLED_RST_SET(); 
	
	OLED_WrCmd(0xAE); /*display off*/
	OLED_WrCmd(0x00); /*set lower column address*/
	OLED_WrCmd(0x10); /*set higher column address*/
	OLED_WrCmd(0x40); /*set display start line*/ 
	OLED_WrCmd(0xB0); /*set page address*/
	OLED_WrCmd(0x81); /*contract control*/ 
	OLED_WrCmd(0xFF); /*128*/
	OLED_WrCmd(0xA1); /*set segment remap*/ 
	OLED_WrCmd(0xA6); /*normal / reverse*/
	OLED_WrCmd(0xA8); /*multiplex ratio*/ 
	OLED_WrCmd(0x3F); /*duty = 1/64*/
	OLED_WrCmd(0xC8); /*Com scan direction*/
	OLED_WrCmd(0xD3); /*set display offset*/ 
	OLED_WrCmd(0x00);
	OLED_WrCmd(0xD5); /*set osc division*/ 
	OLED_WrCmd(0x80);
	OLED_WrCmd(0xD9); /*set pre-charge period*/ 
	OLED_WrCmd(0XF1);
	OLED_WrCmd(0xDA); /*set COM pins*/ 
	OLED_WrCmd(0x12);
	OLED_WrCmd(0xDB); /*set vcomh*/ 
	OLED_WrCmd(0x30);
	OLED_WrCmd(0x8D); /*set charge pump disable*/ 
	OLED_WrCmd(0x14);
	OLED_WrCmd(0xAF); /*display ON*/
	OLED_Fill(0);
	
} 
